## drivers/media/platform/imx8/Kconfig
```kconfig
if VIDEO_MX8_CAPTURE
menu "IMX8 Camera ISI/MIPI Features support"

config IMX8_MIPI_CSI2_YAV
	tristate "IMX8 MIPI CSI2 Controller Yet Another Version"
	default y

config MXC_CAMERA_AR1335
        tristate "AR1335 Camera driver support"
        depends on I2C && VIDEO_ECAM
        default m
        help
          Enable support for video4linux camera sensor driver for eCAM131_CUIMX8

endmenu
endif #VIDEO_MX8_CAPTURE
```
